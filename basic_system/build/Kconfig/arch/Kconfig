## basic_system/build/Kconfig/arch/Kconfig
```kconfig
# Load Zephyr Arch Kconfig descriptions.
osource "/home/madfury/zephyr/zephyr/arch/rx/Kconfig"
osource "/home/madfury/zephyr/zephyr/arch/x86/Kconfig"
osource "/home/madfury/zephyr/zephyr/arch/xtensa/Kconfig"
osource "/home/madfury/zephyr/zephyr/arch/sparc/Kconfig"
osource "/home/madfury/zephyr/zephyr/arch/riscv/Kconfig"
osource "/home/madfury/zephyr/zephyr/arch/posix/Kconfig"
osource "/home/madfury/zephyr/zephyr/arch/mips/Kconfig"
osource "/home/madfury/zephyr/zephyr/arch/arm64/Kconfig"
osource "/home/madfury/zephyr/zephyr/arch/arm/Kconfig"
osource "/home/madfury/zephyr/zephyr/arch/arc/Kconfig"
```

## basic_system/build/Kconfig/boards/Kconfig.defconfig
```kconfig
# Load Zephyr board defconfig descriptions.
osource "/home/madfury/zephyr/zephyr/boards/st/stm32f4_disco/Kconfig.defconfig"
```

## basic_system/build/Kconfig/boards/Kconfig.sysbuild
```kconfig
# Load Sysbuild board Kconfig descriptions.
osource "/home/madfury/zephyr/zephyr/boards/st/stm32f4_disco/Kconfig.sysbuild"
```
